//
// Created by XYKJ on 2026/7/7.
//

#include "calibration_table.h"
#include <math.h>

/* GSM：ADL5906A 功率检测芯片校准表，ADC/mV 采样值 -> dBm*10 */
#if CALIB_ENABLE_GSM_TABLE
const uint16_t ad_5906_mv_adc[] = {
    3100, 3100, 3100, 3100, 3096, 3086, 3071, 3058, 3046, 3034,
    3022, 3013, 3002, 2992, 2982, 2971, 2963, 2955, 2947, 2939,
    2931, 2924, 2918, 2908, 2900, 2896, 2887, 2878, 2868, 2859,
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    691,  683,  675,  667,  662,  653
};

const int16_t ad_5906_dbmX10[] = {
    50, 48, 46, 44, 42, 40, 38, 36, 34, 32,
    30, 28, 26, 24, 22, 20, 18, 16, 14, 12,
    10, 8, 6, 4, 2, 0, -2, -4, -6, -8,
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    -490, -492, -494, -496, -498, -500
};
#define AD_5906_TABLE_LENGTH ((uint16_t)(sizeof(ad_5906_mv_adc) / sizeof(ad_5906_mv_adc[0])))

/**
 * @brief  获取 ADL5906A 校准表长度
 *
 * @return 表项数量，单位：个
 */
uint16_t Calibration_Get5906TableLength(void)
{
    return AD_5906_TABLE_LENGTH;
}

/**
 * @brief  使用 ADL5906A 校准表将 ADC/mV 采样值换算为 dBm
 *
 * @param value      当前 ADC/mV 采样值
 * @param offset_db  外部链路补偿，单位 dB
 * @param out_dbm    输出功率，单位 dBm
 *
 * @return true 换算成功，false 参数错误或表无效
 */
bool Calibration_5906AdcToDbm(uint16_t value,
                              float offset_db,
                              float* out_dbm)
{
    return Calibration_AdcToDbm(ad_5906_mv_adc,
                                ad_5906_dbmX10,
                                AD_5906_TABLE_LENGTH,
                                value,
                                offset_db,
                                out_dbm);
}
#endif

/* DMR：AD8361 功率检测芯片校准表，ADC/mV 采样值 -> dBm*10 */
#if CALIB_ENABLE_DMR_TABLE
const uint16_t ad_8361_mv_adc[615] = {
        3343, 3258, 2467, 2354, 2348, 2341, 2335, 2327, 2319, 2311, 2308, 2304,
        2300, 2296, 2292, 2288, 2285, 2281, 2277, 2273, 2269, 2265, 2260, 2254,
        2249, 2244, 2239, 2234, 2228, 2222, 2216, 2212, 2207, 2203, 2200, 2196,
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        23, 0, 0
};
const int16_t ad_8361_dbmX10[615] = {
        190, 150, 100, 91, 90, 89, 88, 87, 86, 85,
        84, 83, 82, 81, 80, 79, 78, 77, 76, 75,
        74, 73, 72, 71, 70, 69, 68, 67, 66, 65,
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        -542, -550, -600, -700, -800,
};

#define AD_8361_TABLE_LENGTH ((uint16_t)(sizeof(ad_8361_mv_adc) / sizeof(ad_8361_mv_adc[0])))

/**
 * @brief  获取 AD8361 校准表长度
 *
 * @return 表项数量，单位：个
 */
uint16_t Calibration_Get8361TableLength(void)
{
    return AD_8361_TABLE_LENGTH;
}

/**
 * @brief  使用 AD8361 校准表将 ADC/mV 采样值换算为 dBm
 *
 * @param value      当前 ADC/mV 采样值
 * @param offset_db  外部链路补偿，单位 dB
 * @param out_dbm    输出功率，单位 dBm
 *
 * @return true 换算成功，false 参数错误或表无效
 */
bool Calibration_8361AdcToDbm(uint16_t value,
                              float offset_db,
                              float* out_dbm)
{
    return Calibration_AdcToDbm(ad_8361_mv_adc,
                                ad_8361_dbmX10,
                                AD_8361_TABLE_LENGTH,
                                value,
                                offset_db,
                                out_dbm);
}
#endif

/**
 * @brief  根据降序 ADC/mV 表查表插值，得到 dBm
 *
 * @param ad_table        ADC/mV 输入表，要求降序排列
 * @param dbm_x10_table   dBm*10 输出表，长度必须和 ad_table 一致
 * @param len             表长度
 * @param value           当前 ADC/mV 值
 * @param offset_db       补偿偏移，单位 dB，例如 +1.5f
 * @param out_dbm         输出 dBm，例如 -23.4f
 *
 * @return true 成功，false 参数错误
 */
bool Calibration_AdcToDbm(const uint16_t ad_table[],
                          const int16_t dbm_x10_table[],
                          uint16_t len,
                          uint16_t value,
                          float offset_db,
                          float* out_dbm)
{
    if (ad_table == nullptr || dbm_x10_table == nullptr || out_dbm == nullptr) {
        return false;
    }

    if (len < 2) {
        return false;
    }

    // 两端夹紧：表是降序，ad_table[0] 最大，ad_table[len - 1] 最小
    if (value >= ad_table[0]) {
        *out_dbm = ((float)dbm_x10_table[0] * 0.1f) + offset_db;
        return true;
    }

    if (value <= ad_table[len - 1]) {
        *out_dbm = ((float)dbm_x10_table[len - 1] * 0.1f) + offset_db;
        return true;
    }

    // 找到区间：ad_table[i] >= value >= ad_table[i + 1]
    for (uint16_t i = 0; i < len - 1; ++i) {
        uint16_t x0 = ad_table[i];
        uint16_t x1 = ad_table[i + 1];

        if (value <= x0 && value >= x1) {
            float y0 = (float)dbm_x10_table[i] * 0.1f;
            float y1 = (float)dbm_x10_table[i + 1] * 0.1f;

            float dx = (float)x1 - (float)x0;
            float dv = (float)value - (float)x0;

            if (dx == 0.0f) {
                *out_dbm = y0 + offset_db;
                return true;
            }

            // 线性插值：y = y0 + (y1 - y0) * (value - x0) / (x1 - x0)
            *out_dbm = y0 + (y1 - y0) * dv / dx + offset_db;
            return true;
        }
    }

    return false;
}

/**
 * @brief  根据降序 ADC/mV 表查表插值，得到线性功率 uW
 *
 * @param ad_table   ADC/mV 输入表，要求降序排列
 * @param uw_table   uW 输出表，长度必须和 ad_table 一致
 * @param len        表长度
 * @param value      当前 ADC/mV 值
 * @param offset_uw  线性功率补偿，单位 uW
 * @param out_uw     输出功率，单位 uW
 *
 * @return true 成功，false 参数错误或未找到区间
 */
bool Calibration_AdcToUw(const uint16_t ad_table[],
                         const uint32_t uw_table[],
                         uint16_t len,
                         uint16_t value,
                         int32_t offset_uw,
                         uint32_t* out_uw)
{
    if (ad_table == nullptr || uw_table == nullptr || out_uw == nullptr) {
        return false;
    }

    if (len < 2) {
        return false;
    }

    uint32_t power_uw = 0;

    // 两端夹紧：表是降序
    if (value >= ad_table[0]) {
        power_uw = uw_table[0];
    } else if (value <= ad_table[len - 1]) {
        power_uw = uw_table[len - 1];
    } else {
        bool found = false;

        for (uint16_t i = 0; i < len - 1; ++i) {
            uint16_t x0 = ad_table[i];
            uint16_t x1 = ad_table[i + 1];

            if (value <= x0 && value >= x1) {
                uint32_t y0 = uw_table[i];
                uint32_t y1 = uw_table[i + 1];

                int32_t dx = (int32_t)x1 - (int32_t)x0;
                int32_t dv = (int32_t)value - (int32_t)x0;

                if (dx == 0) {
                    power_uw = y0;
                } else {
                    int64_t dy = (int64_t)y1 - (int64_t)y0;
                    int64_t interp = (int64_t)y0 + dy * dv / dx;

                    if (interp < 0) {
                        interp = 0;
                    }

                    power_uw = (uint32_t)interp;
                }

                found = true;
                break;
            }
        }

        if (!found) {
            return false;
        }
    }

    // offset_uw 是线性功率偏移，直接相加
    int64_t corrected = (int64_t)power_uw + (int64_t)offset_uw;

    if (corrected <= 0) {
        *out_uw = 0;
        return true;
    }

    if (corrected > 0xFFFFFFFFLL) {
        *out_uw = 0xFFFFFFFFu;
        return true;
    }

    *out_uw = (uint32_t)corrected;
    return true;
}

/**
 * @brief  将对数功率 dBm 换算为线性功率 uW
 *
 * 公式：
 *   P(mW) = 10 ^ (dBm / 10)
 *   P(uW) = 1000 * 10 ^ (dBm / 10)
 *
 * @param dbm     输入功率，单位 dBm
 * @param out_uw  输出功率，单位 uW
 *
 * @return true 成功，false 参数错误
 */
bool Calibration_DbmToUw(float dbm, uint32_t* out_uw)
{
    if (out_uw == nullptr) {
        return false;
    }

    float uw = 1000.0f * powf(10.0f, dbm / 10.0f);
    if (uw <= 0.0f) {
        *out_uw = 0;
        return true;
    }

    if (uw >= 4294967295.0f) {
        *out_uw = 0xFFFFFFFFu;
        return true;
    }

    *out_uw = (uint32_t)(uw + 0.5f);
    return true;
}

/**
 * @brief  将线性功率 uW 换算为对数功率 dBm
 *
 * 公式：
 *   P(mW) = P(uW) / 1000
 *   dBm = 10 * log10(P(uW) / 1000)
 *
 * @param uw       输入功率，单位 uW，必须大于 0
 * @param out_dbm  输出功率，单位 dBm
 *
 * @return true 成功，false 参数错误或输入功率为 0
 */
bool Calibration_UwToDbm(uint32_t uw, float* out_dbm)
{
    if (out_dbm == nullptr || uw == 0) {
        return false;
    }

    *out_dbm = 10.0f * log10f((float)uw / 1000.0f);
    return true;
}
